## achilles/daq2/software/daq2_fit_spl_fpga.its
```
// SPDX-License-Identifier: GPL-2.0
 /*
 * Copyright (C) 2019 Intel Corporation <www.intel.com>
 *
 */

/dts-v1/;

/ {
	description = "FIT image with FPGA core bistream";
	#address-cells = <1>;

	images {
		fpga-core-1 {
			description = "FPGA core bitstream for DAQ2 on Achilles";
			data = /incbin/("../../../daq2_achilles.core.rbf");
			type = "fpga";
			arch = "arm";
			compression = "none";
		};
	};

	configurations {
		default = "config-1";
		config-1 {
			description = "Configure FPGA core image";
			fpga = "fpga-core-1";
		};
	};
};
```
